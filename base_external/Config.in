## base_external/Config.in
```kconfig
source "$BR2_EXTERNAL_EXTERNAL_BASE_PATH/package/aesd-socket/Config.in"
source "$BR2_EXTERNAL_EXTERNAL_BASE_PATH/package/ldd/Config.in"
source "$BR2_EXTERNAL_EXTERNAL_BASE_PATH/package/aesd-assignments/Config.in"
```

## base_external/package/ldd/Config.in
```kconfig
config BR2_PACKAGE_LDD
	bool "ldd"
	help
	    Includes the device drivers from ldd book.
```
